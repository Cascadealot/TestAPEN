/**
 * @file ssd1306.c
 * @brief SSD1306 OLED Display Driver Implementation
 */

#include "ssd1306.h"
#include "esp_log.h"
#include <string.h>
#include <stdarg.h>

static const char *TAG = "SSD1306";

// SSD1306 Commands
#define SSD1306_CMD_DISPLAY_OFF         0xAE
#define SSD1306_CMD_DISPLAY_ON          0xAF
#define SSD1306_CMD_SET_CONTRAST        0x81
#define SSD1306_CMD_NORMAL_DISPLAY      0xA6
#define SSD1306_CMD_SET_MUX_RATIO       0xA8
#define SSD1306_CMD_SET_DISPLAY_OFFSET  0xD3
#define SSD1306_CMD_SET_START_LINE      0x40
#define SSD1306_CMD_SET_SEG_REMAP       0xA1
#define SSD1306_CMD_SET_COM_SCAN_DEC    0xC8
#define SSD1306_CMD_SET_COM_PINS        0xDA
#define SSD1306_CMD_SET_CLK_DIV         0xD5
#define SSD1306_CMD_SET_PRECHARGE       0xD9
#define SSD1306_CMD_SET_VCOMH           0xDB
#define SSD1306_CMD_CHARGE_PUMP         0x8D
#define SSD1306_CMD_MEM_ADDR_MODE       0x20
#define SSD1306_CMD_SET_COL_ADDR        0x21
#define SSD1306_CMD_SET_PAGE_ADDR       0x22

// Display parameters
#define DISPLAY_WIDTH   128
#define MAX_HEIGHT      64
#define CHARS_PER_LINE  16
#define FONT_WIDTH      8
#define FONT_HEIGHT     8

// State
static i2c_port_t g_i2c_num = I2C_NUM_0;
static SemaphoreHandle_t g_i2c_mutex = NULL;
static uint8_t g_height = 64;
static uint8_t g_pages = 8;
static bool g_initialized = false;

// Display buffer (128 x 64 / 8 = 1024 bytes max)
static uint8_t g_buffer[DISPLAY_WIDTH * MAX_HEIGHT / 8];

// Simple 8x8 font (ASCII 32-127)
static const uint8_t font8x8[][8] = {
    {0x00,0x00,0x00,0x00,0x00,0x00,0x00,0x00}, // 32 space
    {0x00,0x00,0x5F,0x00,0x00,0x00,0x00,0x00}, // 33 !
    {0x00,0x07,0x00,0x07,0x00,0x00,0x00,0x00}, // 34 "
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    {0x08,0x1C,0x2A,0x08,0x08,0x00,0x00,0x00}, // 127 DEL (arrow)
};

/*============================================================================
 * I2C Helpers
 *============================================================================*/

static bool i2c_acquire(uint32_t timeout_ms) {
    if (g_i2c_mutex == NULL) return true;
    return xSemaphoreTake(g_i2c_mutex, pdMS_TO_TICKS(timeout_ms)) == pdTRUE;
}

static void i2c_release(void) {
    if (g_i2c_mutex != NULL) {
        xSemaphoreGive(g_i2c_mutex);
    }
}

static esp_err_t ssd1306_cmd(uint8_t cmd) {
    uint8_t buf[2] = {0x00, cmd};  // Co=0, D/C#=0 (command)
    return i2c_master_write_to_device(g_i2c_num, SSD1306_I2C_ADDR, buf, 2, pdMS_TO_TICKS(100));
}

static esp_err_t ssd1306_cmd2(uint8_t cmd, uint8_t arg) {
    uint8_t buf[3] = {0x00, cmd, arg};
    return i2c_master_write_to_device(g_i2c_num, SSD1306_I2C_ADDR, buf, 3, pdMS_TO_TICKS(100));
}

static esp_err_t ssd1306_data(const uint8_t *data, size_t len) {
    // Send in chunks with data prefix
    uint8_t buf[129];  // 1 prefix + 128 data max
    buf[0] = 0x40;     // Co=0, D/C#=1 (data)

    size_t offset = 0;
    while (offset < len) {
        size_t chunk = len - offset;
        if (chunk > 128) chunk = 128;
        memcpy(&buf[1], &data[offset], chunk);
        esp_err_t err = i2c_master_write_to_device(g_i2c_num, SSD1306_I2C_ADDR, buf, chunk + 1, pdMS_TO_TICKS(100));
        if (err != ESP_OK) return err;
        offset += chunk;
    }
    return ESP_OK;
}

/*============================================================================
 * Public API
 *============================================================================*/

esp_err_t ssd1306_init(i2c_port_t i2c_num, SemaphoreHandle_t i2c_mutex, uint8_t height) {
    esp_err_t err;

    g_i2c_num = i2c_num;
    g_i2c_mutex = i2c_mutex;
    g_height = (height == 32) ? 32 : 64;
    g_pages = g_height / 8;

    if (!i2c_acquire(500)) {
        ESP_LOGE(TAG, "Failed to acquire I2C");
        return ESP_ERR_TIMEOUT;
    }

    // Initialization sequence
    err = ssd1306_cmd(SSD1306_CMD_DISPLAY_OFF);
    if (err != ESP_OK) {
        ESP_LOGE(TAG, "Display not responding");
        i2c_release();
        return err;
    }

    ssd1306_cmd2(SSD1306_CMD_SET_CLK_DIV, 0x80);
    ssd1306_cmd2(SSD1306_CMD_SET_MUX_RATIO, g_height - 1);
    ssd1306_cmd2(SSD1306_CMD_SET_DISPLAY_OFFSET, 0x00);
    ssd1306_cmd(SSD1306_CMD_SET_START_LINE | 0x00);
    ssd1306_cmd2(SSD1306_CMD_CHARGE_PUMP, 0x14);  // Enable charge pump
    ssd1306_cmd2(SSD1306_CMD_MEM_ADDR_MODE, 0x00);  // Horizontal addressing
    ssd1306_cmd(SSD1306_CMD_SET_SEG_REMAP);  // Segment remap
    ssd1306_cmd(SSD1306_CMD_SET_COM_SCAN_DEC);  // COM scan direction

    // COM pins configuration depends on height
    if (g_height == 32) {
        ssd1306_cmd2(SSD1306_CMD_SET_COM_PINS, 0x02);
    } else {
        ssd1306_cmd2(SSD1306_CMD_SET_COM_PINS, 0x12);
    }

    ssd1306_cmd2(SSD1306_CMD_SET_CONTRAST, 0xCF);
    ssd1306_cmd2(SSD1306_CMD_SET_PRECHARGE, 0xF1);
    ssd1306_cmd2(SSD1306_CMD_SET_VCOMH, 0x40);
    ssd1306_cmd(SSD1306_CMD_NORMAL_DISPLAY);
    ssd1306_cmd(SSD1306_CMD_DISPLAY_ON);

    i2c_release();

    // Clear buffer
    memset(g_buffer, 0, sizeof(g_buffer));
    g_initialized = true;

    ESP_LOGI(TAG, "SSD1306 initialized (%dx%d)", DISPLAY_WIDTH, g_height);
    return ESP_OK;
}

void ssd1306_clear(void) {
    memset(g_buffer, 0, DISPLAY_WIDTH * g_pages);
}

void ssd1306_write_line(uint8_t line, const char *text) {
    if (!g_initialized || line >= g_pages) return;

    // Clear line in buffer
    memset(&g_buffer[line * DISPLAY_WIDTH], 0, DISPLAY_WIDTH);

    // Write characters
    size_t len = strlen(text);
    if (len > CHARS_PER_LINE) len = CHARS_PER_LINE;

    for (size_t i = 0; i < len; i++) {
        char c = text[i];
        if (c < 32 || c > 127) c = '?';

        const uint8_t *glyph = font8x8[c - 32];
        size_t x = i * FONT_WIDTH;
        memcpy(&g_buffer[line * DISPLAY_WIDTH + x], glyph, FONT_WIDTH);
    }
}

void ssd1306_printf(uint8_t line, const char *fmt, ...) {
    char buf[CHARS_PER_LINE + 1];
    va_list args;
    va_start(args, fmt);
    vsnprintf(buf, sizeof(buf), fmt, args);
    va_end(args);
    ssd1306_write_line(line, buf);
}

void ssd1306_update(void) {
    if (!g_initialized) return;

    if (!i2c_acquire(100)) return;

    // Set column address range
    ssd1306_cmd(SSD1306_CMD_SET_COL_ADDR);
    ssd1306_cmd(0x00);  // Start
    ssd1306_cmd(DISPLAY_WIDTH - 1);  // End

    // Set page address range
    ssd1306_cmd(SSD1306_CMD_SET_PAGE_ADDR);
    ssd1306_cmd(0x00);  // Start
    ssd1306_cmd(g_pages - 1);  // End

    // Send buffer
    ssd1306_data(g_buffer, DISPLAY_WIDTH * g_pages);

    i2c_release();
}

void ssd1306_set_contrast(uint8_t contrast) {
    if (!g_initialized) return;
    if (!i2c_acquire(100)) return;
    ssd1306_cmd2(SSD1306_CMD_SET_CONTRAST, contrast);
    i2c_release();
}

void ssd1306_display_on(bool on) {
    if (!g_initialized) return;
    if (!i2c_acquire(100)) return;
    ssd1306_cmd(on ? SSD1306_CMD_DISPLAY_ON : SSD1306_CMD_DISPLAY_OFF);
    i2c_release();
}
