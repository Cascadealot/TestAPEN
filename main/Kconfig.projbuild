## main/Kconfig.projbuild
```kconfig
menu "TestAPEN Configuration"

    choice TESTAPEN_NODE_TYPE
        prompt "Node Type"
        default TESTAPEN_NODE_MASTER
        help
            Select which node type to build.
            Master Node: IMU, GNSS, Display, BLE, Autopilot control
            Rudder Node: Encoder, Motor driver, Servo control
            UI Node: e-Paper display, Button input, ESP-NOW listener

        config TESTAPEN_NODE_MASTER
            bool "Master Node"
            help
                Build firmware for the Master Node.
                Includes: IMU, GNSS, Display, BLE, Autopilot control.

        config TESTAPEN_NODE_RUDDER
            bool "Rudder Node"
            help
                Build firmware for the Rudder Node.
                Includes: AS5600 encoder, Motor driver, Servo control.

        config TESTAPEN_NODE_UI
            bool "UI Node"
            help
                Build firmware for the UI Node.
                Includes: e-Paper display, Button input, ESP-NOW listener.
    endchoice

    menu "ESP-NOW Configuration"
        config ESPNOW_MASTER_MAC
            string "Master Node MAC Address"
            default "78:42:1C:6C:FA:58"
            help
                MAC address of the Master node for ESP-NOW peer.
                Format: XX:XX:XX:XX:XX:XX (uppercase hex).
                Use 'status' command or esptool.py read_mac to find actual MAC.

        config ESPNOW_RUDDER_MAC
            string "Rudder Node MAC Address"
            default "78:42:1C:6D:28:94"
            help
                MAC address of the Rudder node for ESP-NOW peer.
                Format: XX:XX:XX:XX:XX:XX (uppercase hex).

        config ESPNOW_UI_MAC
            string "UI Node MAC Address"
            default "78:42:1C:6B:E5:F0"
            help
                MAC address of the UI node for ESP-NOW peer.
                Format: XX:XX:XX:XX:XX:XX (uppercase hex).

        config ESPNOW_CHANNEL
            int "WiFi Channel for ESP-NOW"
            default 0
            range 0 13
            help
                WiFi channel for ESP-NOW. Must match across all nodes.
                Set to 0 to use WiFi station's channel (if connected to AP).
                If not connected to AP, channel 1 will be used.
    endmenu

    config TESTAPEN_I2C_SDA_GPIO
        int "I2C SDA GPIO"
        default 21
        help
            GPIO pin for I2C data.

    config TESTAPEN_I2C_SCL_GPIO
        int "I2C SCL GPIO"
        default 22
        help
            GPIO pin for I2C clock.

    config TESTAPEN_STATUS_LED_GPIO
        int "Status LED GPIO"
        default 2
        help
            GPIO pin for status LED.

    menu "Master Node Configuration"
        depends on TESTAPEN_NODE_MASTER

        config TESTAPEN_GNSS_RX_GPIO
            int "GNSS RX GPIO"
            default 16
            help
                GPIO pin for GNSS UART receive.

        config TESTAPEN_GNSS_TX_GPIO
            int "GNSS TX GPIO"
            default 17
            help
                GPIO pin for GNSS UART transmit.
    endmenu

    menu "Rudder Node Configuration"
        depends on TESTAPEN_NODE_RUDDER

        config TESTAPEN_MOTOR_PWM_GPIO
            int "Motor PWM GPIO"
            default 26
            help
                GPIO pin for motor PWM output.

        config TESTAPEN_MOTOR_DIR_GPIO
            int "Motor Direction GPIO"
            default 25
            help
                GPIO pin for motor direction control.

        config TESTAPEN_MOTOR_EN_GPIO
            int "Motor Enable GPIO"
            default 27
            help
                GPIO pin for motor enable (optional).
    endmenu

    menu "UI Node Configuration"
        depends on TESTAPEN_NODE_UI

        config TESTAPEN_EPAPER_TEST
            bool "e-Paper Partial Refresh Test Mode"
            default n
            help
                Enable minimal test mode for e-Paper partial refresh.
                Displays a compass heading that increments every second.
                Uses 159-byte LUT and 0x0F partial update command.
                Disables normal UI node functionality.

        menu "Button GPIO Pins"
            config TESTAPEN_BTN_DEC10_GPIO
                int "Button -10 deg GPIO"
                default 36
                help
                    GPIO for -10 degree heading button.

            config TESTAPEN_BTN_DEC1_GPIO
                int "Button -1 deg GPIO"
                default 39
                help
                    GPIO for -1 degree heading button.

            config TESTAPEN_BTN_ENGAGE_GPIO
                int "Button Engage GPIO"
                default 34
                help
                    GPIO for engage/disengage button.

            config TESTAPEN_BTN_MODE_GPIO
                int "Button Mode GPIO"
                default 35
                help
                    GPIO for mode/page button.

            config TESTAPEN_BTN_INC1_GPIO
                int "Button +1 deg GPIO"
                default 32
                help
                    GPIO for +1 degree heading button.

            config TESTAPEN_BTN_INC10_GPIO
                int "Button +10 deg GPIO"
                default 33
                help
                    GPIO for +10 degree heading button.
        endmenu

        menu "e-Paper Display GPIO Pins"
            config TESTAPEN_EPAPER_BUSY_GPIO
                int "e-Paper BUSY GPIO"
                default 3
                help
                    GPIO for e-Paper busy signal (input).

            config TESTAPEN_EPAPER_RST_GPIO
                int "e-Paper RST GPIO"
                default 27
                help
                    GPIO for e-Paper reset signal.

            config TESTAPEN_EPAPER_DC_GPIO
                int "e-Paper DC GPIO"
                default 19
                help
                    GPIO for e-Paper data/command select.

            config TESTAPEN_EPAPER_CS_GPIO
                int "e-Paper CS GPIO"
                default 17
                help
                    GPIO for e-Paper chip select.

            config TESTAPEN_EPAPER_CLK_GPIO
                int "e-Paper CLK GPIO"
                default 18
                help
                    GPIO for e-Paper SPI clock.

            config TESTAPEN_EPAPER_DIN_GPIO
                int "e-Paper DIN GPIO"
                default 23
                help
                    GPIO for e-Paper SPI data in (MOSI).
        endmenu
    endmenu

    menu "Network Configuration"
        # Available for all nodes

        config TESTAPEN_WIFI_SSID
            string "WiFi SSID"
            default "YourNetwork"
            help
                WiFi network name.

        config TESTAPEN_WIFI_PASSWORD
            string "WiFi Password"
            default "YourPassword"
            help
                WiFi network password.

        config TESTAPEN_DEBUG_PORT
            int "Debug Console Port"
            default 2323
            help
                TCP port for network debug console.
    endmenu

endmenu
```

## sdkconfig.defaults
```kconfig
# TestAP2 Default Configuration
# Generated from FSD v1.0.0

# Target: ESP32
CONFIG_IDF_TARGET="esp32"

# Flash size
CONFIG_ESPTOOLPY_FLASHSIZE_4MB=y

# Log level
CONFIG_LOG_DEFAULT_LEVEL_INFO=y

# FreeRTOS
CONFIG_FREERTOS_HZ=1000

# Default to Master Node
CONFIG_TESTAP2_NODE_MASTER=y

# GPIO defaults
CONFIG_TESTAP2_CAN_TX_GPIO=5
CONFIG_TESTAP2_CAN_RX_GPIO=4
CONFIG_TESTAP2_I2C_SDA_GPIO=21
CONFIG_TESTAP2_I2C_SCL_GPIO=22
CONFIG_TESTAP2_STATUS_LED_GPIO=2

# Master node GPIO
CONFIG_TESTAP2_GNSS_RX_GPIO=16
CONFIG_TESTAP2_GNSS_TX_GPIO=17

# Rudder node GPIO (for when building Rudder node)
CONFIG_TESTAP2_MOTOR_PWM_GPIO=25
CONFIG_TESTAP2_MOTOR_DIR_GPIO=26
CONFIG_TESTAP2_MOTOR_EN_GPIO=27

# WiFi (Master node)
CONFIG_TESTAP2_WIFI_SSID="Boathouse24"
CONFIG_TESTAP2_WIFI_PASSWORD="Landfall40!@"
CONFIG_TESTAP2_DEBUG_PORT=2323
```
